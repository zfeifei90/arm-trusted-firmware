// SPDX-License-Identifier: (GPL-2.0+ OR BSD-3-Clause)
/*
 * Copyright (c) 2021, STMicroelectronics - All Rights Reserved
 */

/ {
	st-mem-encrypt {
		compatible = "st,mem-encrypt";
		memory-ranges = <DDR_SEC_BASE DDR_SEC_SIZE MCE_ENCRYPT>;
	};
};
